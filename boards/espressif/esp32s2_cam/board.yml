## boards/espressif/esp32s2_cam/board.yml
```yaml
board:
  name: esp32s2_cam
  full_name: ESP32-S2-CAM
  vendor: espressif
  socs:
  - name: esp32s2
```

## drivers/stepper/allegro/Kconfig
```kconfig
# SPDX-FileCopyrightText: Copyright (c) 2025 Marvin Ouma
# SPDX-License-Identifier: Apache-2.0

config STEPPER_ALLEGRO
	bool
	depends on STEPPER

rsource "Kconfig.a4988"
```

## drivers/stepper/allegro/Kconfig.a4988
```kconfig
# SPDX-FileCopyrightText: Copyright (c) 2025 Marvin Ouma
# SPDX-License-Identifier: Apache-2.0

config A4988
       bool "A4988 DMOS Microstepping Driver"
       default y
       depends on DT_HAS_ALLEGRO_A4988_ENABLED
       select STEPPER_ALLEGRO
       select STEP_DIR_STEPPER
       select STEPPER_STEP_DIR_GENERATE_ISR_SAFE_EVENTS
       help
        Enable A4988 DMOS Microstepping Driver.
```

## dts/bindings/stepper/allegro/allegro,a4988.yaml
```yaml
# SPDX-FileCopyrightText: Copyright (c) 2025 Marvin Ouma
# SPDX-License-Identifier: Apache-2.0

description: |
  Allegro A4988 stepper motor driver.

  Example:
  a4988: a4988 {
    status = "okay";
    compatible = "allegro,a4988";

    step-gpios = <&gpio0 15 GPIO_ACTIVE_HIGH>;
    dir-gpios = <&gpio0 2 GPIO_ACTIVE_HIGH>;
    en-gpios = <&gpio0 4 GPIO_ACTIVE_HIGH>;
    msx-gpios = <&gpio0 16 GPIO_ACTIVE_HIGH>,
                <&gpio0 17 GPIO_ACTIVE_HIGH>,
                <&gpio0 5 GPIO_ACTIVE_HIGH>;
  };

compatible: "allegro,a4988"

include:
  - name: stepper-controller.yaml
    property-allowlist:
      - micro-step-res
      - step-gpios
      - dir-gpios
      - en-gpios


properties:
  msx-gpios:
    type: phandle-array
    description: |
      An array of GPIO pins for configuring the microstep resolution of the driver.
      The pins should be listed in the following order:
        - MS1
        - MS2
        - MS3

  sleep-gpios:
    type: phandle-array
    description: Sleep pin

  reset-gpios:
    type: phandle-array
    description: Reset pin
```

## tests/posix/pthread_base/testcase.yaml
```yaml
common:
  tags:
    - posix
    - pthread_base
  min_ram: 64
  timeout: 240
  # 1 tier0 platform per supported architecture
  platform_key:
    - arch
    - simulation
  filter: not CONFIG_NATIVE_LIBC
tests:
  portability.posix.pthread_base: {}
  portability.posix.pthread_base.minimal:
    extra_configs:
      - CONFIG_MINIMAL_LIBC=y
  portability.posix.pthread_base.newlib:
    filter: TOOLCHAIN_HAS_NEWLIB == 1
    extra_configs:
      - CONFIG_NEWLIB_LIBC=y
  portability.posix.pthread_base.picolibc:
    tags: picolibc
    filter: CONFIG_PICOLIBC_SUPPORTED
    extra_configs:
      - CONFIG_PICOLIBC=y
```
